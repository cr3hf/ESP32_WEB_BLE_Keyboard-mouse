## main/Kconfig.projbuild
```kconfig
menu "Example Configuration"

    orsource "$IDF_PATH/examples/common_components/env_caps/$IDF_TARGET/Kconfig.env_caps"

    config LED_STATUS_GPIO
        int "Status LED GPIO number"
        range ENV_GPIO_RANGE_MIN ENV_GPIO_OUT_RANGE_MAX
        default 1
        help
            GPIO number (IOxx) for the status LED.
            The LED is driven by a plain GPIO: low level = ON (action running),
            high level = OFF (idle). Default is GPIO1.

endmenu
```
